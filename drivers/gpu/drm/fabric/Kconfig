## drivers/gpu/drm/fabric/Kconfig
```kconfig
# SPDX-License-Identifier: GPL-2.0

config DRM_FABRIC
	tristate "DRM fabric support"
	depends on DRM && NET
	help
	  Enable DRM fabric support. This infrastructure exposes
	  registered accelerator interconnect topologies to userspace
	  through the drm-fabric generic netlink family.

	  To compile this as a module, choose M here: the module will be
	  called drm-fabric.

	  If in doubt, say N.
```
